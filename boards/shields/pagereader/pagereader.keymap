/*
 * Copyright (c) 2020 The ZMK Contributors
 *
 * SPDX-License-Identifier: MIT
 */

#include <behaviors.dtsi>
#include <dt-bindings/zmk/keys.h>
#include <dt-bindings/zmk/bt.h>

#define DEF 0
#define CTR 1

/ {
    keymap {
        compatible = "zmk,keymap";

        default_layer {
            bindings = <
			&kp UP
			&kp DOWN
			&lt 1 RET
            >;
		sensor-bindings = <&inc_dec_kp DOWN UP>;
        };
		
        ctrl_layer {
            bindings = <
			&bt BT_CLR_ALL
			&bootloader
			&trans
			>;
		sensor-bindings = <&inc_dec_kp DOWN UP>;
	    };
    };
};
